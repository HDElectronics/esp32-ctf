## components/track_crypto/Kconfig
```kconfig
menu "CTF crypto track"

config CTF_CRYPTO_DEV
    bool "Crypto track dev self-test (prints derived CRY-01 key shards at boot)"
    default n
    help
        Development only (SPEC "Cross-track rules", dev self-test). Prints all
        four CRY-01 key shards at boot so the CRY-01 solver can be tested
        before the BLE/BTC/web tracks exist. Release builds keep it off.

endmenu
```

## components/track_hw/Kconfig
```kconfig
menu "CTF hardware track"

    config CTF_HW_DEV
        bool "HW track dev self-test (prints derived values)"
        default n
        help
            Adds the `hwdev` console command: prints the per-board PWM
            frequency (and measures it with PCNT), the touch code, touch raw
            readings and samples the Morse LED. For testing only; release
            builds must keep this off.

endmenu
```

## components/track_web/Kconfig
```kconfig
menu "CTF web track"

config CTF_WEB_DEV_STA
    bool "Web track dev station mode (APSTA, joins a test network)"
    default n
    help
        Development only. In net mode the board runs Wi-Fi APSTA: the hidden
        SoftAP as usual, plus a station that joins the network below so the
        web solvers can reach every service from a LAN host without joining
        the board's AP. The SoftAP follows the station's channel. The STA IP
        is printed on the console as `web dev sta ip: x.x.x.x` and `wifi`
        also shows the active AP SSID. Release builds keep this off.
        Put the three options in a git-ignored sdkconfig.*.local file.

config CTF_WEB_DEV_STA_SSID
    string "Dev station: network SSID (2.4 GHz)"
    depends on CTF_WEB_DEV_STA
    default ""

config CTF_WEB_DEV_STA_PASS
    string "Dev station: network password"
    depends on CTF_WEB_DEV_STA
    default ""

endmenu
```

## main/Kconfig.projbuild
```kconfig
menu "ESP32 CTF"

config CTF_SIZE_PROBE
    bool "Link BT/Wi-Fi/HTTP/mDNS stubs to measure image size"
    default n
    help
        Development only. Adds calls into Bluedroid (BLE GATTS + Classic SPP),
        Wi-Fi, esp_http_server and mdns so the linker keeps those stacks and
        `idf.py size` reflects the final firmware footprint. The calls are
        never executed. Leave disabled.

endmenu
```
